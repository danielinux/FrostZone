## frosted/Kconfig
```kconfig
mainmenu "Frosted Kernel Configuration"

choice
    prompt "Target platform"
    default TARGET_STM32H563

config TARGET_STM32H563
    bool "STM32H563"

config TARGET_STM32U585
    bool "STM32U585"

config TARGET_RP2350
    bool "RP2350 / Pico 2"

endchoice

config SHLIB
    bool "Enable bFLT shared libraries"
    default n
    help
      Enable kernel support for shared-library bFLT objects stored in xipfs.
      Keep this disabled to preserve the classic standalone bFLT loader path.

menu "System layout"

config SYS_CLOCK
    int "System clock frequency (Hz)"
    default 250000000 if TARGET_STM32H563
    default 160000000 if TARGET_STM32U585
    default 120000000 if TARGET_RP2350
    help
      Core clock that the kernel uses for systick calculations and
      peripheral timing.

config APPS_ORIGIN
    hex "Userland image origin"
    default 0x08040000 if TARGET_STM32H563
    default 0x08040000 if TARGET_STM32U585
    default 0x10030000 if TARGET_RP2350
    help
      Base flash address where the userland binary image is stored.

config FLASH_ORIGIN
    hex "Kernel flash origin"
    default 0x08010000 if TARGET_STM32H563
    default 0x08010000 if TARGET_STM32U585
    default 0x10010000 if TARGET_RP2350
    help
      Base flash address for the kernel binary. Must match the linker script.

config LINK_MTU
    int "Default network MTU"
    default 1514
    help
      Default MTU advertised by network interfaces.

config HEAP_SEGMENT_GRANULARITY
    int "Heap segment growth granularity (bytes)"
    default 4096
    range 8 1048576
    help
      Allocation backing obtained from secure_mmap() is rounded up to a
      multiple of this value when the kernel grows a task heap.

config HEAP_SEGMENT_MIN_SIZE
    int "Minimum heap segment size (bytes)"
    default 8192
    range 8 1048576
    help
      Minimum size of a newly mapped heap segment. This can be larger than
      the growth granularity to reduce the number of heap regions consumed
      by allocation-heavy tasks.

endmenu

menu "Kernel features"

config FLASHFS
    bool "Enable FlashFS"
    default y if TARGET_STM32H563
    default n
    help
      Adds the FlashFS filesystem implementation and related hooks.

config FLASHFS_VERIFY
    bool "Verify FlashFS writes"
    depends on FLASHFS
    default y
    help
      Perform a read-back verification after FlashFS writes.

config SHLIB
    bool "Shared library support (bFLT dynamic linking)"
    default n
    help
      Enable shared library loading for bFLT binaries.
      Libraries are packed in xipfs with XIPFS_MAGIC_SHLIB and
      resolved at load time via per-process trampolines.

config EXTENDED_MEMFAULT
    bool "Extended Memfault collection"
    default y

config RELOCATE_VECTORS_TO_RAM
    bool "Relocate interrupt vectors to RAM"
    default n

config MPU
    bool "Enable MPU enforcement"
    default y

config SIGNALS
    bool "Enable POSIX-style signals"
    default y

config PIPE
    bool "Enable POSIX pipes"
    default y
    help
      Build pipe syscall support (pipe2 handler, buffering, polling).

config PROCFS
    bool "Enable /sys/proc/<pid>/mem process info"
    default y
    help
      Expose per-process memory diagnostics under /sys/proc/<pid>/mem.
      Shows stack, RAM (data+bss), and heap region details for each task.

config CORE_DUMP
    bool "Generate ELF core on segfault"
    default n
    help
      When enabled the kernel writes /var/core after fatal faults so gdb can
      inspect the saved registers and memory snapshot.

config PTY_UNIX
    bool "Enable UNIX98 PTYs"
    default y

config DEVTTY_CONSOLE
    bool "Built-in TTY console device"
    default y

config DEVFRAMEBUFFER
    bool "Framebuffer devices"
    default y

config DEVFBCON
    bool "Framebuffer console"
    depends on DEVFRAMEBUFFER
    default y

endmenu

menu "Device drivers"

menu "STM32 hardware crypto"
    depends on TARGET_STM32H563

config STM32_HW_HASH
    bool "HASH accelerator (/dev/hash)"
    default y
    help
      Expose the STM32 HASH accelerator through the /dev/hash device.

config STM32_HW_AES
    bool "AES accelerator (/dev/aes)"
    default y
    help
      Expose the STM32 AES accelerator through the /dev/aes device.

config STM32_HW_PKA
    bool "PKA accelerator (/dev/pka)"
    default y
    help
      Expose the STM32 PKA accelerator through the /dev/pka device.

endmenu

menu "SPI buses"
    depends on TARGET_STM32H563

config SPI1
    bool "Enable SPI1 peripheral support"
    default n

config SPI2
    bool "Enable SPI2 peripheral support"
    default n

config SPI3
    bool "Enable SPI3 peripheral support"
    default n

endmenu

menu "JEDEC SPI Flash per bus"
    depends on TARGET_STM32H563

    if SPI1

    config SPI1_JEDEC_FLASH
        bool "JEDEC SPI Flash on SPI1"
        depends on SPI1
        default n

        if SPI1_JEDEC_FLASH

        config SPI1_JEDEC_FLASH_CS
            int "CS pin number"
            default 3
            help
                GPIO pin number used for the SPI flash chip-select line.

        config SPI1_JEDEC_FLASH_GPIO_BANK
            string "GPIO bank for CS pin"
            default "GPIOA"
            help
                GPIO bank containing the CS pin (GPIOA-GPIOH).

        config SPI1_JEDEC_FLASH_BAUD
            int "SPI clock (Hz)"
            default 50000000
            range 100000 100000000
            help
                Clock rate for the SPI bus connected to the external flash.

        endif
    endif

    if SPI2

    config SPI2_JEDEC_FLASH
        bool "JEDEC SPI Flash on SPI2"
        depends on SPI2
        default n

        if SPI2_JEDEC_FLASH

        config SPI2_JEDEC_FLASH_CS
            int "CS pin number"
            default 12
            help
                GPIO pin number used for the SPI flash chip-select line.

        config SPI2_JEDEC_FLASH_GPIO_BANK
            string "GPIO bank for CS pin"
            default "GPIOB"
            help
                GPIO bank containing the CS pin (GPIOA-GPIOH).

        config SPI2_JEDEC_FLASH_BAUD
            int "SPI clock (Hz)"
            default 50000000
            range 100000 100000000
            help
                Clock rate for the SPI bus connected to the external flash.

        endif
    endif

    if SPI3

    config SPI3_JEDEC_FLASH
        bool "JEDEC SPI Flash on SPI3"
        depends on SPI3
        default n

        if SPI3_JEDEC_FLASH

        config SPI3_JEDEC_FLASH_CS
            int "CS pin number"
            default 8
            help
                GPIO pin number used for the SPI flash chip-select line.

        config SPI3_JEDEC_FLASH_GPIO_BANK
            string "GPIO bank for CS pin"
            default "GPIOC"
            help
                GPIO bank containing the CS pin (GPIOA-GPIOH).

        config SPI3_JEDEC_FLASH_BAUD
            int "SPI clock (Hz)"
            default 50000000
            range 100000 100000000
            help
                Clock rate for the SPI bus connected to the external flash.

        endif
    endif

endmenu

config JEDEC_MAX_PAGES
    int "JEDEC flash usable page count"
    default 128
    depends on SPI1_JEDEC_FLASH || SPI2_JEDEC_FLASH || SPI3_JEDEC_FLASH
    help
        Maximum number of flash pages available on the external chip for
        FlashFS. The usable capacity is JEDEC_MAX_PAGES * JEDEC_FLASH_PAGE_SIZE.
        This also determines the size of the in-RAM bitmap at build time, so
        choose conservatively when RAM is tight.

config JEDEC_FLASH_PAGE_SIZE
    int "JEDEC flash page size in bytes"
    default 256
    range 64 4096
    depends on SPI1_JEDEC_FLASH || SPI2_JEDEC_FLASH || SPI3_JEDEC_FLASH
    help
        Size of one flash-page block on the external JEDEC device.
        Use 256 for standard SPI NOR, or 4096 (4 KB) if the chip
        uses "page" as the smallest erase unit (e.g. NAND-style).

config JEDEC_SPI_FLASH
    bool "Enable JEDEC SPI flash support"
    depends on SPI1_JEDEC_FLASH || SPI2_JEDEC_FLASH || SPI3_JEDEC_FLASH
    help
        Probe for a JEDEC SPI flash device at boot and expose it as
        /dev/spiflash0 for explicit userspace mounting with FlashFS.

endmenu

menu "Display peripherals"

config ILI9341
    bool "ILI9341 SPI display"
    depends on DEVFRAMEBUFFER
    default n

endmenu

menu "Networking"

config TCPIP
    bool "Enable TCP/IP stack"
    default y

config ETH
    bool "STM32 Ethernet MAC"
    depends on TCPIP
    default y if TARGET_STM32U585
    default n

config DEVUSB
    bool "TinyUSB device stack"
    default y if TARGET_STM32H563
    default y if TARGET_RP2350

config CFG_TUD_ENABLED
    bool "Enable TinyUSB device controller"
    depends on DEVUSB
    default y

config USB_NET
    bool "USB CDC-NCM network interface"
    depends on DEVUSB && TCPIP
    default y if TARGET_STM32H563
    default y if TARGET_RP2350

config LOOPBACK
    bool "Loopback interface (127.0.0.1)"
    depends on TCPIP
    default y
    help
      Enable the software loopback network interface. Requires
      WOLFIP_MAX_INTERFACES >= 2.

config IP_FORWARD
    bool "IP forwarding between interfaces"
    depends on TCPIP
    default n
    help
      Forward IP packets between network interfaces (router mode).

menu "TCP/IP Settings"
    depends on TCPIP

config MAX_TCPSOCKETS
    int "Maximum TCP sockets"
    default 4
    help
      Number of simultaneous TCP connections the stack can handle.

config MAX_UDPSOCKETS
    int "Maximum UDP sockets"
    default 2
    help
      Number of simultaneous UDP endpoints.

config MAX_ICMPSOCKETS
    int "Maximum ICMP sockets"
    default 1
    help
      Number of raw ICMP sockets (used by ping).

config RXBUF_SIZE
    int "Socket receive buffer size (bytes)"
    default 1024

config TXBUF_SIZE
    int "Socket transmit buffer size (bytes)"
    default 1024

config MAX_NEIGHBORS
    int "Maximum neighbor table entries"
    default 4
    help
      ARP / neighbor-discovery cache slots.

config WOLFIP_MAX_INTERFACES
    int "Maximum network interfaces"
    default 2
    help
      Must be >= 2 when loopback is enabled.

endmenu

endmenu
```

## secure-supervisor/Kconfig
```kconfig
mainmenu "Secure Supervisor Configuration"

choice
    prompt "Target platform"
    default TARGET_STM32H563

config TARGET_STM32H563
    bool "STM32H563"

config TARGET_STM32U585
    bool "STM32U585"

config TARGET_RP2350
    bool "RP2350 / Pico 2"

endchoice

config ETH
    bool "Enable Ethernet controller bring-up"
    default y if TARGET_STM32U585
    default n

config FLASHFS_VERIFY
    bool "Verify FlashFS writes"
    default y
    help
      When enabled, every secure-world FlashFS operation is immediately
      verified with a read-back compare.

menu "Memory Layout"

config MEMPOOL_START
    hex "Mempool start address"
    default 0x20060000 if TARGET_STM32H563
    default 0x30030000 if TARGET_STM32U585
    default 0x20020000 if TARGET_RP2350
    help
      Base address of the non-secure memory pool used for task heap and
      stack allocations.  Must be aligned to the SRAM bank layout and
      fall within the SAU non-secure RAM window.

config MEMPOOL_SIZE
    hex "Mempool size (bytes)"
    default 0x38000 if TARGET_STM32H563
    default 0x50000 if TARGET_STM32U585
    default 0x60000 if TARGET_RP2350
    help
      Total size of the memory pool region.  On STM32H563 the pool must
      end before the USB and Ethernet DMA buffers (0x20098000).

config TASK_STACK_SIZE
    int "Default task stack size (bytes)"
    default 8192
    help
      Stack size allocated for each new task from the memory pool.

config TASK_MAX_MEM
    int "Maximum memory per task (bytes)"
    default 131072
    help
      Hard limit on total memory (stack + heap) a single task may hold.

endmenu
```
